; lcd
PUBLIC LCD_RS
	LCD_RS		bit		080h	; Port 0.0
		
PUBLIC LCD_EN
	LCD_EN		bit		081h	; Port 0.1
		
PUBLIC LCD_DATA
	LCD_DATA	data	0A0h	; Port 2
		
; keyboard
PUBLIC KEYBOARD
	KEYBOARD 	data 	090h 	; Port 1

PUBLIC KEYBOARD_COL1
	KEYBOARD_COL1	bit		090h	; Port 1.0

PUBLIC KEYBOARD_COL2
	KEYBOARD_COL2	bit		091h	; Port 1.1

PUBLIC KEYBOARD_COL3
	KEYBOARD_COL3	bit		092h	; Port 1.2

PUBLIC KEYBOARD_COL4
	KEYBOARD_COL4	bit		093h	; Port 1.3

PUBLIC KEYBOARD_ROW1
	KEYBOARD_ROW1	bit		094h	; Port 1.4

PUBLIC KEYBOARD_ROW2
	KEYBOARD_ROW2	bit		095h	; Port 1.5

PUBLIC KEYBOARD_ROW3
	KEYBOARD_ROW3	bit		096h	; Port 1.6

PUBLIC KEYBOARD_ROW4
	KEYBOARD_ROW4	bit		097h	; Port 1.7
		
END